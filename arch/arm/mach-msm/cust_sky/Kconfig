## drivers/net/wireless/bcm4330_b2/Kconfig
```kconfig
config BCM4330_B2
	tristate "Broadcom BCM4330 wireless chip support"
	depends on WIRELESS_EXT && MMC
	---help---
	  This module adds support for wireless adapters based on
	  Broadcom 4330 chipset.

	  This driver uses the kernel's wireless extensions subsystem.

config BCM4330_WL_RESET_GPIO
	depends on BCM4330_B2
	int "BCM4330 WLAN Reset GPIO number"
	default 135

config BCM4330_FW_PATH
	depends on BCM4330_B2
	string "Firmware path"
	default "/etc/wl/bcm4330.bin"
	---help---
	  Path to the firmware file.

config BCM4330_NVRAM_PATH
	depends on BCM4330_B2
	string "NVRAM path"
	default "/etc/wl/nvram.txt"
	---help---
	  Path to the nvram file.

config BCM4330_IFACE_NAME
	depends on BCM4330_B2
	string "Wireless network interface name"
	default "wlan"

config BCM4330_DEBUG
	depends on BCM4330_B2
	bool "Debug"
	default n

config BCM4330_SOFTAP
	depends on BCM4330_B2
	bool "Support SoftAP function"
	default y

config BCM4330_OOB_GPIO
	depends on BCM4330_B2
	int "BCM4330 out-of-band GPIO number"
	default 126

config BCM4330_ROAM_ENABLE
	depends on BCM4330_B2
	bool "Enable roaming"
	default n

config BCM4330_USE_CSCAN
	depends on BCM4330_B2
	bool "Using combo scan"
	default n

config BCM4330_HT_WEP_ENABLE
	depends on BCM4330_B2
	bool "Enable HT_WEP"
	default n
```

## drivers/tdmb/Kconfig
```kconfig
#
# For a description of the syntax of this configuration file,
# see Documentation/kbuild/kconfig-language.txt.
#
# TDMB configuration.
#

menu "TDMB - Terrestrial Digital Multimedia Broadcasting"

config SKY_TDMB
  bool "SKY_TDMB support"
  default n
  ---help---
   Say Y here if you have a TDMB device

   If unsure, say Y.


if SKY_TDMB

config SKY_TDMB_MODULE
  tristate "SKY_TDMB_MODULE"
  default n
  depends on SKY_TDMB
  ---help---
   select this option for "TDMB" hardware support


###################################################################
# TDMB BB Chip

config SKY_TDMB_INC_BB
  bool "SKY_TDMB_INC_BB"
  default n
  depends on SKY_TDMB
  ---help---
   select this option for "TDMB" hardware support


if SKY_TDMB_INC_BB

config SKY_TDMB_INC_BB_T3700
  bool "SKY_TDMB_INC_BB_T3700"
  default n
  depends on SKY_TDMB_INC_BB
  ---help---
   select this option for "TDMB" hardware support


config SKY_TDMB_INC_BB_T3900
  bool "SKY_TDMB_INC_BB_T3900"
  default n
  depends on SKY_TDMB_INC_BB
  ---help---
   select this option for "TDMB" hardware support

endif # SKY_TDMB_INC_BB


config SKY_TDMB_FCI_BB
  bool "SKY_TDMB_FCI_BB"
  default n
  depends on SKY_TDMB
  ---help---
   select this option for "TDMB" hardware support


if SKY_TDMB_FCI_BB

config SKY_TDMB_FCI_BB_FC8050
  bool "SKY_TDMB_FCI_BB_FC8050"
  default n
  depends on SKY_TDMB_FCI_BB
  ---help---
   select this option for "TDMB" hardware support

endif # SKY_TDMB_FCI_BB


config SKY_TDMB_RTV_BB
  bool "SKY_TDMB_RTV_BB"
  default n
  depends on SKY_TDMB
  ---help---
   select this option for "TDMB" hardware support


if SKY_TDMB_RTV_BB

config SKY_TDMB_RTV_BB_MTV350
  bool "SKY_TDMB_RTV_BB_MTV350"
  default n
  depends on SKY_TDMB_RTV_BB
  ---help---
   select this option for "TDMB" hardware support

endif # SKY_TDMB_RTV_BB


config SKY_TDMB_TCC_BB
  bool "SKY_TDMB_TCC_BB"
  default n
  depends on SKY_TDMB
  ---help---
   select this option for "TDMB" hardware support

if SKY_TDMB_TCC_BB

config SKY_TDMB_TCC_BB_TCC3170
  bool "SKY_TDMB_TCC_BB_TCC3170"
  default n
  depends on SKY_TDMB_TCC_BB
  ---help---
   select this option for "TDMB" hardware support

endif # SKY_TDMB_TCC_BB


###################################################################
# TDMB BB Interface

config SKY_TDMB_EBI_IF
  bool "SKY_TDMB_EBI_IF"
  default n
  depends on SKY_TDMB
  ---help---
   select this option for "TDMB" hardware support


if SKY_TDMB_EBI_IF

config SKY_TDMB_EBI_CMD
  bool "SKY_TDMB_EBI_CMD"
  default n
  depends on SKY_TDMB_EBI_IF
  ---help---
   select this option for "TDMB" hardware support

endif # SKY_TDMB_EBI_IF


config SKY_TDMB_TSIF_IF
  bool "SKY_TDMB_TSIF_IF"
  default n
  depends on SKY_TDMB
  ---help---
   select this option for "TDMB" hardware support


config SKY_TDMB_I2C_CMD
  bool "SKY_TDMB_I2C_CMD"
  default n
  depends on SKY_TDMB
  ---help---
   select this option for "TDMB" hardware support


if SKY_TDMB_I2C_CMD

config SKY_TDMB_I2C_HW
  bool "SKY_TDMB_I2C_HW"
  default n
  depends on SKY_TDMB_I2C_CMD
  ---help---
   select this option for "TDMB" hardware support


config SKY_TDMB_I2C_GPIO
  bool "SKY_TDMB_I2C_GPIO"
  default n
  depends on SKY_TDMB_I2C_CMD
  ---help---
   select this option for "TDMB" hardware support

endif # SKY_TDMB_I2C_CMD

config SKY_TDMB_SPI_IF
  bool "SKY_TDMB_SPI_IF"
  default n
  depends on SKY_TDMB
  ---help---
   select this option for "TDMB" hardware support


if SKY_TDMB_SPI_IF

config SKY_TDMB_SPI_CMD
  bool "SKY_TDMB_SPI_CMD"
  default n
  depends on SKY_TDMB_SPI_IF
  ---help---
   select this option for "TDMB" hardware support

if SKY_TDMB_SPI_CMD

config SKY_TDMB_SPI_QUP
  bool "SKY_TDMB_SPI_QUP"
  default n
  depends on SKY_TDMB_SPI_CMD
  ---help---
   select this option for "TDMB" hardware support


config SKY_TDMB_SPI_GPIO
  bool "SKY_TDMB_SPI_GPIO"
  default n
  depends on SKY_TDMB_SPI_CMD
  ---help---
   select this option for "TDMB" hardware support

endif # SKY_TDMB_SPI_CMD

endif # SKY_TDMB_SPI_IF


###################################################################
# TDMB ANT PATH

config SKY_TDMB_MICRO_USB_DETECT
  bool "SKY_TDMB_MICRO_USB_DETECT"
  default n
  depends on SKY_TDMB
  ---help---
   select this option for "TDMB" hardware support


###################################################################

endif # SKY_TDMB

endmenu
```

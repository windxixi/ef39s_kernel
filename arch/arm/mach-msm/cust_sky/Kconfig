## drivers/input/sensor/Kconfig
```kconfig
#
# Sensor driver configuration
#
menuconfig INPUT_SENSOR
	bool "Sensors"
	default n
	help
	  Say Y here, and a list of supported sensorss will be displayed.
	  This option doesn't affect the kernel.

	  If unsure, say Y.

if INPUT_SENSOR

#### EF39S ####
if MACH_MSM8X60_EF39S
config EF39S_SENSORS_APDS9900_SW
	tristate "Avago apds9900 proximity and light sensor"
	depends on I2C
	default n
	help
	  Say Y here if you have a APDS9900 sensor and want to enable
	  support for the built-in sensor.

config EF39S_SENSORS_MPU3050
	tristate "InvenSense mpu3050 gyro sensor"
	depends on I2C
	default n
	help
	  Say Y here if you have a MPU3050 sensor and want to enable
	  support for the built-in sensor.

config EF39S_SENSORS_MPU_DEBUG
	tristate "InvenSense mpu debug enable"
	depends on EF39S_SENSORS_MPU3050
	default n
	help
	  Say Y here if you have a yas529 sensor and want to enable
	  support for the built-in sensor.

config EF39S_SENSORS_BMA150
	tristate "Bocsh bma150 accelerometer sensor"
	depends on EF39S_SENSORS_MPU3050
	default n
	help
	  Say Y here if you have a bma150 sensor and want to enable
	  support for the built-in sensor.

config EF39S_SENSORS_BMA250
	tristate "Bocsh bma250 accelerometer sensor"
	depends on EF39S_SENSORS_MPU3050
	default n
	help
	  Say Y here if you have a bma250 sensor and want to enable
	  support for the built-in sensor.

config EF39S_SENSORS_YAS530
	tristate "Yamaha yas529 magnetic field sensor"
	depends on EF39S_SENSORS_MPU3050
	default n
	help
	  Say Y here if you have a yas530 sensor and want to enable
	  support for the built-in sensor.
endif

#### EF40K ####
if MACH_MSM8X60_EF40K
config EF40K_SENSORS_APDS9900_SW
	tristate "Avago apds9900 proximity and light sensor"
	depends on I2C
	default n
	help
	  Say Y here if you have a APDS9900 sensor and want to enable
	  support for the built-in sensor.

config EF40K_SENSORS_MPU3050
	tristate "InvenSense mpu3050 gyro sensor"
	depends on I2C
	default n
	help
	  Say Y here if you have a MPU3050 sensor and want to enable
	  support for the built-in sensor.

config EF40K_SENSORS_MPU_DEBUG
	tristate "InvenSense mpu debug enable"
	depends on EF40K_SENSORS_MPU3050
	default n
	help
	  Say Y here if you have a yas529 sensor and want to enable
	  support for the built-in sensor.

config EF40K_SENSORS_BMA150
	tristate "Bocsh bma150 accelerometer sensor"
	depends on EF40K_SENSORS_MPU3050
	default n
	help
	  Say Y here if you have a bma150 sensor and want to enable
	  support for the built-in sensor.

config EF40K_SENSORS_BMA250
	tristate "Bocsh bma250 accelerometer sensor"
	depends on EF40K_SENSORS_MPU3050
	default n
	help
	  Say Y here if you have a bma250 sensor and want to enable
	  support for the built-in sensor.

config EF40K_SENSORS_YAS530
	tristate "Yamaha yas529 magnetic field sensor"
	depends on EF40K_SENSORS_MPU3050
	default n
	help
	  Say Y here if you have a yas530 sensor and want to enable
	  support for the built-in sensor.
endif

#### EF40S ####
if MACH_MSM8X60_EF40S
config EF40S_SENSORS_APDS9900_SW
	tristate "Avago apds9900 proximity and light sensor"
	depends on I2C
	default n
	help
	  Say Y here if you have a APDS9900 sensor and want to enable
	  support for the built-in sensor.

config EF40S_SENSORS_MPU3050
	tristate "InvenSense mpu3050 gyro sensor"
	depends on I2C
	default n
	help
	  Say Y here if you have a MPU3050 sensor and want to enable
	  support for the built-in sensor.

config EF40S_SENSORS_MPU_DEBUG
	tristate "InvenSense mpu debug enable"
	depends on EF40S_SENSORS_MPU3050
	default n
	help
	  Say Y here if you have a yas529 sensor and want to enable
	  support for the built-in sensor.

config EF40S_SENSORS_BMA150
	tristate "Bocsh bma150 accelerometer sensor"
	depends on EF40S_SENSORS_MPU3050
	default n
	help
	  Say Y here if you have a bma150 sensor and want to enable
	  support for the built-in sensor.

config EF40S_SENSORS_BMA250
	tristate "Bocsh bma250 accelerometer sensor"
	depends on EF40S_SENSORS_MPU3050
	default n
	help
	  Say Y here if you have a bma150 sensor and want to enable
	  support for the built-in sensor.

config EF40S_SENSORS_YAS530
	tristate "Yamaha yas529 magnetic field sensor"
	depends on EF40S_SENSORS_MPU3050
	default n
	help
	  Say Y here if you have a yas530 sensor and want to enable
	  support for the built-in sensor.
endif

#### PRESTO ####
if MACH_MSM8X60_PRESTO
config PANTECH_PRESTO_SENSORS_APDS9190
        tristate "Avago apds9190 proximity and light sensor"
        depends on I2C
        default y
        help
          Say Y here if you have a APDS9190 sensor and want to enable
          support for the built-in sensor.

config PANTECH_PRESTO_SENSORS_YAS530
        tristate "Yamaha yas530 magnetic field sensor"
        depends on INPUT_SENSOR
        default y
        help
          Say Y here if you have a yas530 sensor and want to enable
          support for the built-in sensor.

config PANTECH_PRESTO_SENSORS_BMA250
        tristate "Bocsh bma250 accelerometer sensor"
        depends on INPUT_SENSOR
        default y
        help
          Say Y here if you have a bma250 sensor and want to enable
          support for the built-in sensor.

config PANTECH_PRESTO_SENSORS_ORIENTATION
        tristate "YAS Orientation sensor"
        depends on PANTECH_PRESTO_SENSORS_YAS530
        default y
        help
          Say Y here if you have a orientation sensor and want to enable
          support for the built-in sensor.

config SENSOR_POWER_CONTROL
	tristate "Accelermoter & Magnetic sensor power control"
	depends on INPUT_SENSOR
	default y
	help
	  Say Y here if you want to power control
endif

endif
```

## drivers/input/sensor/PRESTO/Kconfig
```kconfig
source "drivers/input/sensor/PRESTO/accelerometer/Kconfig"
source "drivers/input/sensor/PRESTO/geomagnetic/Kconfig"
source "drivers/input/sensor/PRESTO/orientation/Kconfig"
source "drivers/input/sensor/PRESTO/proximity/Kconfig"
```

## drivers/media/video/msm/Kconfig
```kconfig
config MSM_CAMERA_V4L2
        bool "MSM Camera V4L2 Interface"
        depends on MSM_CAMERA
        default n
        ---help---
          This flag enables V4L2 interface of MSM
          camera driver. If enabled, application interacts
          with /dev/video0 through V4L2 APIs. Otherwise,
          native APIs are used through /dev/config0, /dev/frame0,
          and /dev/control0.

comment "Camera Sensor Selection"
config MT9T013
	bool "Sensor mt9t013 (BAYER 3M)"
	depends on MSM_CAMERA && !ARCH_MSM8X60 && !MSM_CAMERA_V4L2 && !PANTECH_CAMERA
	default n
	---help---
	  MICRON 3M Bayer Sensor with AutoFocus

config MT9D112
	bool "Sensor mt9d112 (YUV 2M)"
	depends on MSM_CAMERA && !ARCH_MSM8X60 && !MSM_CAMERA_V4L2 && !PANTECH_CAMERA
	default n
	---help---
	  MICRON 2M YUV Sensor
config IMX074
	bool "Sensor IMX074 (BAYER 13.5M)"
	depends on MSM_CAMERA && ARCH_MSM8X60 && !MSM_CAMERA_V4L2 && !PANTECH_CAMERA
	default n
	---help---
	SONY 13.5 MP Bayer Sensor
config WEBCAM_OV7692
	bool "Sensor OV7692 (VGA YUV)"
	depends on MSM_CAMERA && ARCH_MSM8X60 && !MSM_CAMERA_V4L2 && !PANTECH_CAMERA
	default n
	---help---
	  Omni Vision VGA YUV Sensor.
config WEBCAM_OV9726
	bool "Sensor OV9726 (VGA Bayer)"
	depends on MSM_CAMERA && (ARCH_MSM8X60 || ARCH_MSM7X30) && !MSM_CAMERA_V4L2 && !PANTECH_CAMERA
	default n
	---help---
	  Omni Vision VGA Bayer Sensor.
#	This Senosr is used as a webcam.
#	This uses the CSI interface.
config VX6953
	bool "Sensor VX6953 (BAYER 5M)"
	depends on MSM_CAMERA && ARCH_MSM7X30 && !PANTECH_CAMERA
	default n
	---help---
	STM 5M Bayer Sensor with EDOF
config SN12M0PZ
	bool "Sensor sn12m0pz (Bayer 12 MP)"
	depends on MSM_CAMERA && ARCH_MSM7X30 && !MSM_CAMERA_V4L2 && !PANTECH_CAMERA
	default n
	---help---
	  Sony 12 MP Bayer Sensor
config MT9P012
	bool "Sensor mt9p012 (BAYER 5M)"
	depends on MSM_CAMERA && !ARCH_MSM8X60 && !MSM_CAMERA_V4L2 && !PANTECH_CAMERA
	default n
	---help---
	  MICRON 5M Bayer Sensor with Autofocus

choice
	prompt "AF module"
	depends on MT9P012 && !ARCH_MSM8X60 && !MSM_CAMERA_V4L2 && !PANTECH_CAMERA
	default MSM_CAMERA_AF_FOXCONN

config MSM_CAMERA_AF_FOXCONN
	bool "FOXCONN Module"
	help
	  This driver supports FOXCONN AF module for 5M Bayer sensor

config MSM_CAMERA_AF_BAM
	bool "BAM Module"
	help
	  This driver supports BAM AF module for 5M Bayer sensor

endchoice

config MT9P012_KM
	bool "Sensor mt9p012 KM module (BAYER 5M)"
	depends on MSM_CAMERA && !ARCH_MSM8X60 && !MSM_CAMERA_V4L2 && !PANTECH_CAMERA
	default n
	---help---
	  MICRON 5M Bayer Sensor KM modules with Autofocus

config MT9E013
	bool "Sensor mt9e013 module (BAYER 8M)"
	depends on MSM_CAMERA && (ARCH_MSM7X30 || ARCH_MSM8X60) && !MSM_CAMERA_V4L2 && !PANTECH_CAMERA
	default n
	---help---
	  Aptina 8M Bayer Sensor modules with Autofocus

config S5K3E2FX
	bool "Sensor s5k3e2fx (Samsung 5M)"
	depends on MSM_CAMERA && !ARCH_MSM8X60 && !MSM_CAMERA_V4L2 && !PANTECH_CAMERA
	default n
	---help---
	  Samsung 5M with Autofocus

config QS_S5K4E1
	bool "Sensor qs_s5k4e1 (Samsung 5M)"
	depends on MSM_CAMERA && ARCH_MSM8X60 && !MSM_CAMERA_V4L2 && !PANTECH_CAMERA
	default n
	---help---
	  Samsung 5M with Autofocus

config VB6801
	bool "Sensor vb6801"
	depends on MSM_CAMERA && !ARCH_MSM8X60 && !MSM_CAMERA_V4L2 && !PANTECH_CAMERA
	---help---
	  5M with flash

config PANTECH_CAMERA_CE1612
	bool "ISP CE1612 and Sensor OV8820"
	depends on MSM_CAMERA && ARCH_MSM8X60 && !MSM_CAMERA_V4L2 && PANTECH_CAMERA
	default n
	---help---
	Renesas ISP and OmniVision 8M Bayer Sensor with AutoFocus

config PANTECH_CAMERA_ICP_HD
	bool "ISP ICP_HD and Sensor MT9E013"
	depends on MSM_CAMERA && ARCH_MSM8X60 && !MSM_CAMERA_V4L2 && PANTECH_CAMERA
	default n
	---help---
	Aptina ISP and Aptina 8M Bayer Sensor with AutoFocus

config PANTECH_CAMERA_MT9P111
	bool "Sensor MT9P111 (YUV 5M)"
	depends on MSM_CAMERA && ARCH_MSM8X60 && !MSM_CAMERA_V4L2 && PANTECH_CAMERA
	default n
	---help---
	Aptina 5M YUV Sensor with AutoFocus

config PANTECH_CAMERA_S5K4ECGX
	bool "Sensor S5K4ECGX (YUV 5M)"
	depends on MSM_CAMERA && ARCH_MSM8X60 && !MSM_CAMERA_V4L2 && PANTECH_CAMERA
	default n
	---help---
	Samsung LSI 5M YUV Sensor with AutoFocus

config PANTECH_CAMERA_MT9D113
	bool "Sensor MT9D113 (YUV 2M)"
	depends on MSM_CAMERA && ARCH_MSM8X60 && !MSM_CAMERA_V4L2 && PANTECH_CAMERA
	default n
	---help---
	Aptina 2M YUV Sensor without AutoFocus

config PANTECH_CAMERA_S5K6AAFX13
	bool "Sensor S5K6AAFX13 (YUV 1.3M)"
	depends on MSM_CAMERA && ARCH_MSM8X60 && !MSM_CAMERA_V4L2 && PANTECH_CAMERA
	default n
	---help---
	Samsung LSI 1.3M YUV Sensor without AutoFocus

config PANTECH_CAMERA_MT9V113
	bool "Sensor MT9V113 (YUV VGA)"
	depends on MSM_CAMERA && ARCH_MSM8X60 && !MSM_CAMERA_V4L2 && PANTECH_CAMERA
	default n
	---help---
	Aptina VGA YUV Sensor without AutoFocus

config PANTECH_CAMERA_HW
	bool "Pantech Camera HW Configuration"
	depends on MSM_CAMERA && PANTECH_CAMERA
	default y
	---help---
	Configures camera HW environment. (gpios, regulators,...)

config PANTECH_CAMERA_TUNER
	bool "Pantech Image Tuner Interface for YUV Sensors"
	depends on MSM_CAMERA && !MSM_CAMERA_V4L2 && PANTECH_CAMERA
	default n
	---help---
	Enables image tuner interface for YUV sensors.

config PANTECH_CAMERA_DEBUG
	bool "Pantech Camera Debug with printk"
	depends on MSM_CAMERA && PANTECH_CAMERA
	default y
	---help---
	Enables printk() debug for msm camera.

config MSM_CAMERA_FLASH
	bool "Qualcomm MSM camera flash support"
	depends on MSM_CAMERA
	default y
	---help---
	  Enable support for LED flash for msm camera

config MSM_GEMINI
	tristate "Qualcomm MSM Gemini Jpeg Engine support"
	depends on MSM_CAMERA && (ARCH_MSM7X30 || ARCH_MSM8X60)
	default M
	---help---
	  Enable support for Gemini Jpeg Engine

config MSM_VPE
	tristate "Qualcomm MSM Video Pre-processing Engine support"
	depends on MSM_CAMERA && (ARCH_MSM7X30 || ARCH_MSM8X60)
	default y
	---help---
	  Enable support for Video Pre-processing Engine

config QUP_EXCLUSIVE_TO_CAMERA
	bool "QUP exclusive to camera"
	depends on MSM_CAMERA
	default y
	---help---
	  This flag enabled states that QUP
	  is exclusive to camera. In case this
	  is disabled, the lvs1 voltage is enabled
	  by QUP in the board file as QUP is used by
	  applications other than camera.
```

## drivers/net/wireless/bcm4329/Kconfig
```kconfig
config BCM4329
	tristate "Broadcom BCM4329 wireless chip support"
	depends on WIRELESS_EXT && MMC
	---help---
	  This module adds support for wireless adapters based on
	  Broadcom 4329 chipset.

	  This driver uses the kernel's wireless extensions subsystem.

config BCM4329_WL_RESET_GPIO
	depends on BCM4329
	int "BCM4329 WLAN Reset GPIO number"
	default 107 

config BCM4329_FW_PATH
	depends on BCM4329
	string "Firmware path"
	default "/etc/wl/bcm43291.bin"
	---help---
	  Path to the firmware file.

config BCM4329_NVRAM_PATH
	depends on BCM4329
	string "NVRAM path"
	default "/etc/wl/nvram.txt"
	---help---
	  Path to the nvram file.

config BCM4329_IFACE_NAME
	depends on BCM4329
	string "Wireless network interface name"
	default "wlan"

config BCM4329_DEBUG
	depends on BCM4329
	bool "Debug"
	default n

config BCM4329_SOFTAP
	depends on BCM4329
	bool "Support SoftAP function"
	default y

config BCM4329_OOB_GPIO
	depends on BCM4329
	int "BCM4329 out-of-band GPIO number"
	default 126

config BCM4329_ROAM_ENABLE
	depends on BCM4329
	bool "Enable roaming"
	default n

config BCM4329_USE_CSCAN
	depends on BCM4329
	bool "Using combo scan"
	default n

config BCM4329_HT_WEP_ENABLE
	depends on BCM4329
	bool "Enable HT_WEP"
	default n
```

## drivers/net/wireless/bcm4330/Kconfig
```kconfig
config BCM4330
	tristate "Broadcom BCM4330 wireless chip support"
	depends on WIRELESS_EXT && MMC
	---help---
	  This module adds support for wireless adapters based on
	  Broadcom 4330 chipset.

	  This driver uses the kernel's wireless extensions subsystem.

config BCM4330_WL_RESET_GPIO
	depends on BCM4330
	int "BCM4330 WLAN Reset GPIO number"
	default 135

config BCM4330_FW_PATH
	depends on BCM4330
	string "Firmware path"
	default "/etc/wl/bcm4330.bin"
	---help---
	  Path to the firmware file.

config BCM4330_NVRAM_PATH
	depends on BCM4330
	string "NVRAM path"
	default "/etc/wl/nvram.txt"
	---help---
	  Path to the nvram file.

config BCM4330_IFACE_NAME
	depends on BCM4330
	string "Wireless network interface name"
	default "wlan"

config BCM4330_DEBUG
	depends on BCM4330
	bool "Debug"
	default n

config BCM4330_SOFTAP
	depends on BCM4330
	bool "Support SoftAP function"
	default y

config BCM4330_OOB_GPIO
	depends on BCM4330
	int "BCM4330 out-of-band GPIO number"
	default 126

config BCM4330_ROAM_ENABLE
	depends on BCM4330
	bool "Enable roaming"
	default n

config BCM4330_USE_CSCAN
	depends on BCM4330
	bool "Using combo scan"
	default n

config BCM4330_HT_WEP_ENABLE
	depends on BCM4330
	bool "Enable HT_WEP"
	default n
```

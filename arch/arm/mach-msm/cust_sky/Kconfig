## arch/arm/mach-msm/cust_sky/Kconfig
```kconfig
if CUST_SKY_H

#
# CUST SKY FEATURE SECTION
#
menu "CUST SKY FEATURE SECTION"

config PANTECH
	bool "PANTECH Common Configuration"
	default y
	help
		Support PANTECH


if MACH_MSM8X60_EF39S
config DEFINE_LIST_EF39S
	bool
	default y
	select SKY_EF39S_BOARD
	select PANTECH_CAMERA
	select SKY_GSBI12_UART_CONSOLE
	select SKY_WLAN_MMC
	select PANTECH_ERR_CRASH_LOGGING
	select PANTECH_PWR_ONOFF_REASON_CNT
	select SW_RESET
	select PANTECH_WDOG_WORKAROUND
	select PANTECH_EXT4_RO_REMOUNT_ON_EMERGENCY_RESET
	select SKY_SND_EXTAMP
	select SKY_SND_CTRL
	select SKY_SND_VT_VOIP
	select SKY_SND_MVS
	select SKY_MMC
	select F_SKYDISP_QBUG_FIX_BACKLIGHT
	select F_SKYDISP_BOOT_LOGO_IN_KERNEL
	select F_SKYDISP_LCD_RESET
	select F_SKYDISP_LCD_FORCE_ONOFF
	select F_SKYDISP_FRAMEBUFFER_32
	select F_SKYDISP_NO_CURSOR_IN_BOOT
	select F_SKYDISP_QBUG_FIX_MIPI_ERROR
	select F_SKYDISP_HDMI_OPTION
	select F_SKYDISP_FIX_OVERLAY_FLICKER
	select F_SKYDISP_FIX_Y_CBCR_FLIP
	select SKY_UPGRADE
endif


if MACH_MSM8X60_EF40S
config DEFINE_LIST_EF40S
	bool
	default y
	select SKY_EF40S_BOARD
	select PANTECH_CAMERA
	select SKY_GSBI12_UART_CONSOLE
	select SKY_WLAN_MMC
	select PANTECH_ERR_CRASH_LOGGING
	select PANTECH_PWR_ONOFF_REASON_CNT
	select SW_RESET
	select PANTECH_WDOG_WORKAROUND
	select PANTECH_EXT4_RO_REMOUNT_ON_EMERGENCY_RESET
	select SKY_SND_EXTAMP
	select SKY_SND_CTRL
	select SKY_SND_VT_VOIP
	select SKY_SND_MVS
	select SKY_MMC
	select F_SKYDISP_QBUG_FIX_BACKLIGHT
	select F_SKYDISP_BOOT_LOGO_IN_KERNEL
	select F_SKYDISP_LCD_RESET
	select F_SKYDISP_LCD_FORCE_ONOFF
	select F_SKYDISP_FRAMEBUFFER_32
	select F_SKYDISP_NO_CURSOR_IN_BOOT
	select F_SKYDISP_QBUG_FIX_MIPI_ERROR
	select F_SKYDISP_HDMI_OPTION
	select F_SKYDISP_FIX_OVERLAY_FLICKER
	select F_SKYDISP_FIX_Y_CBCR_FLIP
	select SKY_UPGRADE
endif


if MACH_MSM8X60_EF40K
config DEFINE_LIST_EF40K
	bool
	default y
	select SKY_EF40K_BOARD
	select PANTECH_CAMERA
	select SKY_GSBI12_UART_CONSOLE
	select SKY_WLAN_MMC
	select PANTECH_ERR_CRASH_LOGGING
	select PANTECH_PWR_ONOFF_REASON_CNT
	select SW_RESET
	select PANTECH_WDOG_WORKAROUND
	select PANTECH_EXT4_RO_REMOUNT_ON_EMERGENCY_RESET
	select SKY_SND_EXTAMP
	select SKY_SND_CTRL
	select SKY_SND_VT_VOIP
	select SKY_SND_MVS
	select SKY_MMC
	select F_SKYDISP_QBUG_FIX_BACKLIGHT
	select F_SKYDISP_BOOT_LOGO_IN_KERNEL
	select F_SKYDISP_LCD_RESET
	select F_SKYDISP_LCD_FORCE_ONOFF
	select F_SKYDISP_FRAMEBUFFER_32
	select F_SKYDISP_NO_CURSOR_IN_BOOT
	select F_SKYDISP_QBUG_FIX_MIPI_ERROR
	select F_SKYDISP_HDMI_OPTION
	select F_SKYDISP_FIX_OVERLAY_FLICKER
	select F_SKYDISP_FIX_Y_CBCR_FLIP
	select SKY_UPGRADE
endif


if MACH_MSM8X60_PRESTO
config DEFINE_LIST_PRESTO
	bool
	default y
	select PANTECH_PRESTO_BOARD
	select PANTECH_CAMERA
	select SKY_GSBI12_UART_CONSOLE
	select PANTECH_MTP
	select PANTECH_AUDIO_PRESTO_AUDIENCE2020
	select PANTECH_AUDIO_PRESTO_FAB2200
	select PANTECH_AUDIO_SUBCHIP_CAL_TOOL
	select PANTECH_WIFI_MMC
	select PANTECH_ERR_CRASH_LOGGING
	select PANTECH_PWR_ONOFF_REASON_CNT
	select SW_RESET
	select PANTECH_WDOG_WORKAROUND
	select PANTECH_EXT4_RO_REMOUNT_ON_EMERGENCY_RESET
	select SKY_SND_CTRL
	select SKY_MMC
	select F_SKYDISP_QBUG_FIX_BACKLIGHT
	select F_SKYDISP_BOOT_LOGO_IN_KERNEL
	select F_SKYDISP_LCD_RESET
	select F_SKYDISP_LCD_FORCE_ONOFF
	select F_SKYDISP_FRAMEBUFFER_32
	select F_SKYDISP_NO_CURSOR_IN_BOOT
	select F_SKYDISP_BEAM_ON_BUG_FIX
	select F_SKYDISP_FIX_OVERLAY_FLICKER
	select F_SKYDISP_FIX_Y_CBCR_FLIP
endif


comment "SKY_EF39S_BOARD Configuration"
config SKY_EF39S_BOARD
	bool

comment "SKY_EF40S_BOARD Configuration"
config SKY_EF40S_BOARD
	bool

comment "SKY_EF40K_BOARD Configuration"
config SKY_EF40K_BOARD
	bool

comment "PANTECH_PRESTO_BOARD Configuration"
config PANTECH_PRESTO_BOARD
	bool

config PANTECH_CAMERA
	bool

comment "SKY_GSBI12_UART_CONSOLE Configuration"
config SKY_GSBI12_UART_CONSOLE
	bool

comment "PANTECH_MTP Configuration"
config PANTECH_MTP
	bool

config PANTECH_AUDIO_PRESTO_AUDIENCE2020
	bool

config PANTECH_AUDIO_PRESTO_FAB2200
	bool

config PANTECH_AUDIO_SUBCHIP_CAL_TOOL
	bool

config SKY_SND_CTRL
	bool

comment "PANTECH MMC Configuration"
config SKY_MMC
    bool

comment "SKY WLAN"
config SKY_WLAN
	bool "EF39 WLAN"
	default y
	help
		Support EF39 WLAN

config PANMAC
	bool "WLAN MAC ADDRESS"
	default y
	help
		Support PANMAC

config SKY_WLAN_MMC
	bool		

comment "PANTECH_ERR_CRASH_LOGGING Configuration"
config PANTECH_ERR_CRASH_LOGGING
	bool	

# Added by Sungwook@LS4.2011-09-28
# CONFIG_PANTECH_PWR_ONOFF_REASON_CNT
comment "PANTECH_PWR_ONOFF_REASON_CNT Configuration"
config PANTECH_PWR_ONOFF_REASON_CNT
        bool

# Added by Sungwook@LS4.2011-09-28
# CONFIG_SW_RESET
comment "SW_RESET Configuration"
config SW_RESET
        depends on PANTECH_ERR_CRASH_LOGGING
	depends on PANTECH_PWR_ONOFF_REASON_CNT
	bool

config PANTECH_WDOG_WORKAROUND
	depends on SW_RESET
	bool

# Added by Sungwook@LS4.2011-09-29
# CONFIG_PANTECH_EXT4_RO_REMOUNT_ON_EMERGENCY_RESET
#
# Added by Sungwook@LS4.2011-09-29
# Add options to the reboot syscall to remount filesystems ro
# Auther: Ken Sumrall
# Date: March 03rd, 2011
# Reference from
# http://us.generation-nt.com/answer/patch-syscalls-reboot-add-
# options-reboot-syscall-remount-filesystems-ro-help-202386552.html
#
comment "SW_RESET Configuration"
config PANTECH_EXT4_RO_REMOUNT_ON_EMERGENCY_RESET
        bool
	help
		Add 4 new commands to the reboot system call, that do the same thing as the
		RESTART, HALT, POWER_OFF, and RESTART2 commands, but also remount writable
		filesystems as read-only just before doing what the command normally does.
		Now that Android is using EXT4, and since we don't have a standard init
		setup to unmount filesystems before rebooting, this allows the system to
		reboot with clean filesystems, and also improves boot time as the journal
		does not need to be replayed when mounting the filesystem.		

if MACH_MSM8X60_PRESTO
comment "SKY CHARGING by paiksun"
config SKY_CHARGING
        bool "SKY_CHARGING"
        default y
        help
          	Support SKY CHARGING

      	
endif  

if MACH_MSM8X60_EF39S
comment "SKY SMB136S"
config SKY_SMB_CHARGER
	bool "SKY SMB136S"
	default y
	help
		Support SKY SMB136S
endif

if MACH_MSM8X60_EF40K
comment "SKY SMB136S"
config SKY_SMB_CHARGER
	bool "SKY SMB136S"
	default y
	help
		Support SKY SMB136S
endif

if MACH_MSM8X60_EF40S
comment "SKY SMB136S"
config SKY_SMB_CHARGER
	bool "SKY SMB136S"
	default y
	help
		Support SKY SMB136S
endif

comment "SKY_BATTERY_MAX17040 by p14682 kobj"
config SKY_BATTERY_MAX17040
        bool "SKY_BATTERY_MAX17040"
        default y
        help
          	Support SKY BATTERY MAX17040    

config PANTECH_WIFI_MMC
	bool
    
config SKY_SND_EXTAMP
        bool 
        
config SKY_SND_CTRL
        bool 

config SKY_SND_VT_VOIP
        bool 
        
config SKY_SND_MVS
        bool 

# LCD 2011.07.01 [PS1] Kang Seong-Goo
config F_SKYDISP_QBUG_FIX_BACKLIGHT
        bool 

config F_SKYDISP_BOOT_LOGO_IN_KERNEL
        bool 

config F_SKYDISP_LCD_RESET
        bool 

config F_SKYDISP_LCD_FORCE_ONOFF
        bool 

config F_SKYDISP_QBUG_FIX_MIPI_ERROR
        bool 

config F_SKYDISP_FRAMEBUFFER_32
        bool 

config F_SKYDISP_NO_CURSOR_IN_BOOT
        bool 

config F_SKYDISP_HDMI_OPTION
        bool 

config F_SKYDISP_USE_ASHMEM
        bool 

config F_SKYDISP_FIX_OVERLAY_FLICKER
        bool 

config F_SKYDISP_FIX_Y_CBCR_FLIP
        bool 

config F_SKYDISP_BEAM_ON_BUG_FIX
        bool 

# p14777 upgrade jang
config SKY_UPGRADE
		bool
endmenu

endif
```

## drivers/gpu/msm/Kconfig.rej
```kconfig
--- drivers/gpu/msm/Kconfig
+++ drivers/gpu/msm/Kconfig
@@ -55,41 +54,60 @@
 	  Use hex version for the ring-buffer in the post-mortem dump, instead
 	  of the human readable version.
 
-config MSM_KGSL_PSTMRTMDMP_NO_REG_DUMP
-	bool "Disable dumping of most registers in post-mortem dump"
-	default n
-	depends on MSM_KGSL
-	---help---
-	  For a more compact kernel log the extensive register hex dump
-	  can be turned off with this option.  The register dump takes up
-	  so much space that vital other information gets cut from the
-	  post-mortem dump.
-
 config MSM_KGSL_2D
-	bool "Enable the 2D core. Required for OpenVG"
-	default n
-	depends on MSM_KGSL && !ARCH_MSM7X27
+	tristate "MSM 2D graphics driver. Required for OpenVG"
+	default y
+	depends on MSM_KGSL && !ARCH_MSM7X27 && !ARCH_MSM7X27A && !(ARCH_QSD8X50 && !MSM_SOC_REV_A)
 
 config MSM_KGSL_DRM
 	bool "Build a DRM interface for the MSM_KGSL driver"
 	depends on MSM_KGSL && DRM
 
+config MSM_KGSL_GPUMMU
+	bool "Enable the GPU MMU in the MSM_KGSL driver"
+	depends on MSM_KGSL && !MSM_KGSL_CFF_DUMP
+	default y
+
+config MSM_KGSL_IOMMU
+	bool "Enable the use of IOMMU in the MSM_KGSL driver"
+	depends on MSM_KGSL && MSM_IOMMU && !MSM_KGSL_GPUMMU && !MSM_KGSL_CFF_DUMP
+
 config MSM_KGSL_MMU
-	bool "Enable the GPU MMU in the MSM_KGSL driver"
-	depends on MSM_KGSL && MMU
+	bool
+	depends on MSM_KGSL_GPUMMU || MSM_KGSL_IOMMU
 	default y
 
 config KGSL_PER_PROCESS_PAGE_TABLE
 	bool "Enable Per Process page tables for the KGSL driver"
 	default n
-	depends on MSM_KGSL_MMU && !MSM_KGSL_DRM
+	depends on MSM_KGSL_GPUMMU && !MSM_KGSL_DRM
+	---help---
+	  The MMU will use per process pagetables when enabled.
+
+config MSM_KGSL_PAGE_TABLE_SIZE
+	hex "Size of pagetables"
+	default 0xFFF0000
+	---help---
+	  Sets the pagetable size used by the MMU.  The max value
+	  is 0xFFF0000 or (256M - 64K).
+
+config MSM_KGSL_PAGE_TABLE_COUNT
+	int "Minimum of concurrent pagetables to support"
+	default 8
+	depends on KGSL_PER_PROCESS_PAGE_TABLE
+	---help---
+	  Specify the number of pagetables to allocate at init time
+	  This is the number of concurrent processes that are guaranteed to
+	  to run at any time.  Additional processes can be created dynamically
+	  assuming there is enough contiguous memory to allocate the pagetable.
 
 config MSM_KGSL_MMU_PAGE_FAULT
 	bool "Force the GPU MMU to page fault for unmapped regions"
-	default n
-	depends on MSM_KGSL_MMU
+	default y
+	depends on MSM_KGSL_GPUMMU
 
 config MSM_KGSL_DISABLE_SHADOW_WRITES
 	bool "Disable register shadow writes for context switches"
 	default n
 	depends on MSM_KGSL
+
```

## drivers/input/pantech_earjack_int/Kconfig
```kconfig
#
# Earjack driver configuration
#

menuconfig INPUT_EARJACK
	bool "Earjack"
	default y
	help 
	  Say Y here, and a list of supported sensorss will be displayed.
	  This option doesn't affect the kernel.

	  If unsure, say Y.

if INPUT_EARJACK

config INPUT_PANTECH_EARJACK
	tristate "Pantech Earjack Device"
	default y
	help
	  Say Y here if you have pantech earjack.
endif
```
